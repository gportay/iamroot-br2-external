## Config.in
```kconfig
source "$BR2_EXTERNAL_IAMROOT_PATH/package/archlinuxarm-keyring/Config.in.host"
source "$BR2_EXTERNAL_IAMROOT_PATH/package/iamroot/Config.in.host"
source "$BR2_EXTERNAL_IAMROOT_PATH/package/libcurl/Config.in.host"
source "$BR2_EXTERNAL_IAMROOT_PATH/package/pacman/Config.in.host"
```

## configs/alpinelinux_armv7_defconfig
```kconfig
BR2_arm=y
BR2_cortex_a5=y
BR2_ARM_ENABLE_NEON=y
BR2_ARM_ENABLE_VFP=y
BR2_ARM_FPU_NEON=y
BR2_TOOLCHAIN_EXTERNAL=y
BR2_TOOLCHAIN_EXTERNAL_BOOTLIN=y
BR2_TOOLCHAIN_EXTERNAL_BOOTLIN_ARMV7_EABIHF_MUSL_BLEEDING_EDGE=y
# BR2_STRIP_strip is not set
BR2_ROOTFS_SKELETON_CUSTOM=y
BR2_ROOTFS_SKELETON_CUSTOM_PATH="$(BR2_EXTERNAL_IAMROOT_PATH)/board/skeleton-custom"
BR2_INIT_NONE=y
# BR2_ENABLE_LOCALE_PURGE is not set
# BR2_PACKAGE_BUSYBOX is not set
# BR2_TARGET_ROOTFS_TAR is not set
BR2_PACKAGE_SKELETON_ALPINE_MAKE_ROOTFS=y
BR2_PACKAGE_HOST_ALPINE_KEYS=y
```

## configs/alpinelinux_s390x_defconfig
```kconfig
BR2_s390x=y
BR2_TOOLCHAIN_BUILDROOT_MUSL=y
# BR2_STRIP_strip is not set
BR2_ROOTFS_SKELETON_CUSTOM=y
BR2_ROOTFS_SKELETON_CUSTOM_PATH="$(BR2_EXTERNAL_IAMROOT_PATH)/board/skeleton-custom"
BR2_INIT_NONE=y
# BR2_ENABLE_LOCALE_PURGE is not set
# BR2_PACKAGE_BUSYBOX is not set
# BR2_TARGET_ROOTFS_TAR is not set
BR2_PACKAGE_SKELETON_ALPINE_MAKE_ROOTFS=y
BR2_PACKAGE_HOST_ALPINE_KEYS=y
```

## configs/archlinux32_i686_defconfig
```kconfig
BR2_x86_i686=y
BR2_TOOLCHAIN_EXTERNAL=y
# BR2_STRIP_strip is not set
BR2_ROOTFS_SKELETON_CUSTOM=y
BR2_ROOTFS_SKELETON_CUSTOM_PATH="$(BR2_EXTERNAL_IAMROOT_PATH)/board/skeleton-custom"
BR2_INIT_NONE=y
# BR2_TARGET_ENABLE_ROOT_LOGIN is not set
# BR2_TARGET_GENERIC_REMOUNT_ROOTFS_RW is not set
# BR2_ENABLE_LOCALE_PURGE is not set
# BR2_PACKAGE_BUSYBOX is not set
BR2_PACKAGE_IFUPDOWN_SCRIPTS=y
# BR2_TARGET_ROOTFS_TAR is not set
BR2_PACKAGE_SKELETON_PACSTRAP=y
BR2_PACKAGE_SKELETON_PACSTRAP_CONFIGURATION="$(SKELETON_PACSTRAP_PKGDIR)/i686-archlinux32-pacman.conf"
BR2_PACKAGE_HOST_ARCHLINUX32_KEYRING=y
```

## package/alpine-keys/Config.in.host
```kconfig
config BR2_PACKAGE_HOST_ALPINE_KEYS
	bool "host alpine-keys"
	help
	  Public keys for Alpine Linux packages

	  https://git.alpinelinux.org/aports/tree/main/alpine-keys
```

## package/apk-tools/Config.in.host
```kconfig
config BR2_PACKAGE_HOST_APK_TOOLS
	bool "host apk-tools"
	select BR2_PACKAGE_HOST_OPENSSL
	select BR2_PACKAGE_HOST_PKGCONF
	select BR2_PACKAGE_HOST_ZLIB
	help
	  Alpine Package Keeper (apk) is a package manager
	  originally built for Alpine Linux, but now used by
	  several other distributions as well.

	  https://gitlab.alpinelinux.org/alpine/apk-tools
```

## package/archlinux-keyring/Config.in.host
```kconfig
config BR2_PACKAGE_HOST_ARCHLINUX_KEYRING
	bool "host archlinux-keyring"
	select BR2_PACKAGE_HOST_PKGCONF
	select BR2_PACKAGE_HOST_PYTHON3
	select BR2_PACKAGE_HOST_SEQUOIA_SQ
	help
	  Arch Linux PGP keyring

	  https://gitlab.archlinux.org/archlinux/archlinux-keyring
```

## package/archlinux32-keyring/Config.in.host
```kconfig
config BR2_PACKAGE_HOST_ARCHLINUX32_KEYRING
	bool "host archlinux32-keyring"
	help
	  Arch Linux 32 PGP keyring

	  https://git.archlinux32.org/archlinux32-keyring
```

## package/archlinuxarm-keyring/Config.in.host
```kconfig
config BR2_PACKAGE_HOST_ARCHLINUXARM_KEYRING
	bool "host archlinuxarm-keyring"
	help
	  Arch Linux ARM PGP keyring
	 
	  https://github.com/archlinuxarm/archlinuxarm-keyring 
```

## package/archlinuxriscv-keyring/Config.in.host
```kconfig
config BR2_PACKAGE_HOST_ARCHLINUXRISCV_KEYRING
	bool "host archlinuxriscv-keyring"
	help
	  Arch Linux RISC-V PGP keyring

	  https://github.com/felixonmars/archriscv-packages
```

## package/archpower-keyring/Config.in.host
```kconfig
config BR2_PACKAGE_HOST_ARCHPOWER_KEYRING
	bool "host archpower-keyring"
	help
	  Arch POWER PGP keyring
	  
	  https://github.com/kth5/archpower/tree/master/archpower-keyring
```

## package/archriscv-keyring/Config.in.host
```kconfig
config BR2_PACKAGE_HOST_ARCHRISCV_KEYRING
	bool "host archriscv-keyring"
	help
	  Arch RISC-V PGP keyring
	  
	  https://github.com/felixonmars/archriscv-packages
```

## package/iamroot/Config.in.host
```kconfig
config BR2_PACKAGE_HOST_IAMROOT_ARCH_SUPPORTS
	bool
	# ld-linux.so.3 or ld-musl-arm.so.1 or ld-linux-armhf.so.3 or ld-musl-armhf.so.1
	default y if BR2_arm && (BR2_TOOLCHAIN_USES_GLIBC || BR2_TOOLCHAIN_USES_MUSL)
	# ld-linux-aarch64.so.1 or ld-musl-aarch64.so.1
	default y if BR2_aarch64 && (BR2_TOOLCHAIN_USES_GLIBC || BR2_TOOLCHAIN_USES_MUSL)
	# ld-linux-aarch64_be.so.1 or ld-musl-aarch64_be.so.1
	default y if BR2_aarch64_be && (BR2_TOOLCHAIN_USES_GLIBC || BR2_TOOLCHAIN_USES_MUSL)
	# ld.so.1 or ld-musl-mipsel.so.1
	default y if BR2_mipsel && (BR2_TOOLCHAIN_USES_GLIBC || BR2_TOOLCHAIN_USES_MUSL)
	# ld.so.1 or ld-musl-mips64el.so.1
	default y if BR2_mips64el && (BR2_TOOLCHAIN_USES_GLIBC || BR2_TOOLCHAIN_USES_MUSL)
	# ld.so.2 or ld-musl-powerpc64.so.1
	default y if BR2_powerpc64 && (BR2_TOOLCHAIN_USES_GLIBC || BR2_TOOLCHAIN_USES_MUSL)
	# ld.so.2 or ld-musl-powerpc64le.so.1
	default y if BR2_powerpc64le && (BR2_TOOLCHAIN_USES_GLIBC || BR2_TOOLCHAIN_USES_MUSL)
	# ld.so.1 or ld-musl-s390x.so.1
	default y if BR2_s390x && (BR2_TOOLCHAIN_USES_GLIBC || BR2_TOOLCHAIN_USES_MUSL)
	# ld-linux-riscv64-lp64d.so.1 or ld-musl-riscv64.so.1
	default y if BR2_RISCV_64 && BR2_RISCV_ABI_LP64D && (BR2_TOOLCHAIN_USES_GLIBC || BR2_TOOLCHAIN_USES_MUSL)
	# ld.so.1 or ld-musl-s390x.so.1
	default y if BR2_s390x && (BR2_TOOLCHAIN_USES_GLIBC || BR2_TOOLCHAIN_USES_MUSL)
	# ld-linux.so.2 or ld-musl-i386.so.1
	default y if BR2_i386 && (BR2_TOOLCHAIN_USES_GLIBC || BR2_TOOLCHAIN_USES_MUSL)
	# ld-linux-x86-64.so.2 or ld-musl-x86_64.so.1
	default y if BR2_x86_64 && (BR2_TOOLCHAIN_USES_GLIBC || BR2_TOOLCHAIN_USES_MUSL)

config BR2_PACKAGE_HOST_IAMROOT
	bool "host iamroot"
	depends on BR2_PACKAGE_HOST_IAMROOT_ARCH_SUPPORTS
	help
	  Emulating the syscall chroot(2) for unpriviliged processes in
	  userspace.

	  https://www.portay.io/iamroot/
```

## package/libcurl/Config.in.host
```kconfig
config BR2_PACKAGE_HOST_LIBCURL
	bool "host-libcurl"
	select BR2_PACKAGE_OPENSSL
	help
	  cURL is a tool for getting files from FTP, HTTP, Gopher,
	  Telnet, and Dict servers, using any of the supported
	  protocols.

	  https://curl.se/
```

## package/manjaro-keyring/Config.in.host
```kconfig
config BR2_PACKAGE_HOST_MANJARO_KEYRING
	bool "host manjaro-keyring"
	help
	  Manjaro PGP keyring
	  
	  https://gitlab.manjaro.org/packages/core/manjaro-keyring
```

## package/pacman/Config.in.host
```kconfig
config BR2_PACKAGE_HOST_PACMAN
	bool "host pacman"
	select BR2_PACKAGE_HOST_LIBARCHIVE
	select BR2_PACKAGE_HOST_LIBCURL
	help
	  A library-based package manager with dependency support.

	  https://www.archlinux.org/pacman/
```

## package/sequoia-sq/Config.in.host
```kconfig
config BR2_PACKAGE_SEQUOIA_SQ
	bool "sequoia-sq"
	depends on BR2_PACKAGE_HOST_RUSTC_TARGET_ARCH_SUPPORTS
	select BR2_PACKAGE_HOST_NETTLE
	select BR2_PACKAGE_HOST_OPENSSL
	select BR2_PACKAGE_HOST_PKGCONF
	select BR2_PACKAGE_HOST_RUSTC
	help
	  sq, the Sequoia-PGP command line tool

	  https://gitlab.com/sequoia-pgp/sequoia-sq
```

## package/skeleton-alpine-make-rootfs/Config.in
```kconfig
config BR2_PACKAGE_SKELETON_ALPINE_MAKE_ROOTFS_ARCH_SUPPORTS
	bool
	default y if BR2_arm || BR2_aarch64 || \
		BR2_powerpc64le || BR2_s390x || \
		BR2_i386 || BR2_x86_64

config BR2_PACKAGE_SKELETON_ALPINE_MAKE_ROOTFS
	bool "skeleton-alpine-make-rootfs"
	depends on BR2_PACKAGE_SKELETON_ALPINE_MAKE_ROOTFS_ARCH_SUPPORTS
	select BR2_INIT_NONE
	select BR2_PACKAGE_HOST_ALPINE_MAKE_ROOTFS
	select BR2_PACKAGE_HOST_APK_TOOLS
	select BR2_PACKAGE_HOST_CA_CERTIFICATES
	select BR2_PACKAGE_HOST_IAMROOT

if BR2_PACKAGE_SKELETON_ALPINE_MAKE_ROOTFS

config BR2_PACKAGE_SKELETON_ALPINE_MAKE_ROOTFS_NO_DEFAULT_BASE_PACKAGES
	bool "no default base packages"
	default n
	help
	  Don't install the default base packages
	  (alpine-baselayout busybox busybox-suid musl-utils),
	  i.e. only the packages specified in --packages will
	  be installed. Use only if you know what are you
	  doing!

config BR2_PACKAGE_SKELETON_ALPINE_MAKE_ROOTFS_PACKAGES
	string "additional packages"
	default "alpine-baselayout busybox busybox-suid musl-utils" if BR2_PACKAGE_SKELETON_ALPINE_MAKE_ROOTFS_NO_DEFAULT_BASE_PACKAGES
	default ""
	help
	  Additional packages to install into the rootfs.

choice BR2_PACKAGE_SKELETON_ALPINE_MAKE_ROOTFS_BRANCH
	prompt branch
	default BR2_PACKAGE_SKELETON_ALPINE_MAKE_ROOTFS_LATEST_STABLE_BRANCH

config BR2_PACKAGE_SKELETON_ALPINE_MAKE_ROOTFS_3_9_BRANCH
	bool "3.9"

config BR2_PACKAGE_SKELETON_ALPINE_MAKE_ROOTFS_3_10_BRANCH
	bool "3.10"

config BR2_PACKAGE_SKELETON_ALPINE_MAKE_ROOTFS_3_11_BRANCH
	bool "3.11"

config BR2_PACKAGE_SKELETON_ALPINE_MAKE_ROOTFS_3_12_BRANCH
	bool "3.12"

config BR2_PACKAGE_SKELETON_ALPINE_MAKE_ROOTFS_3_13_BRANCH
	bool "3.13"

config BR2_PACKAGE_SKELETON_ALPINE_MAKE_ROOTFS_3_14_BRANCH
	bool "3.14"

config BR2_PACKAGE_SKELETON_ALPINE_MAKE_ROOTFS_3_15_BRANCH
	bool "3.15"

config BR2_PACKAGE_SKELETON_ALPINE_MAKE_ROOTFS_3_16_BRANCH
	bool "3.16"

config BR2_PACKAGE_SKELETON_ALPINE_MAKE_ROOTFS_3_17_BRANCH
	bool "3.17"

config BR2_PACKAGE_SKELETON_ALPINE_MAKE_ROOTFS_3_18_BRANCH
	bool "3.18"

config BR2_PACKAGE_SKELETON_ALPINE_MAKE_ROOTFS_3_19_BRANCH
	bool "3.19"

config BR2_PACKAGE_SKELETON_ALPINE_MAKE_ROOTFS_LATEST_STABLE_BRANCH
	bool "latest-stable"

config BR2_PACKAGE_SKELETON_ALPINE_MAKE_ROOTFS_EDGE_BRANCH
	bool "edge"

config BR2_PACKAGE_SKELETON_ALPINE_MAKE_ROOTFS_CUSTOM_BRANCH
	bool "custom"

endchoice

if BR2_PACKAGE_SKELETON_ALPINE_MAKE_ROOTFS_CUSTOM_BRANCH

config BR2_PACKAGE_SKELETON_ALPINE_MAKE_ROOTFS_CUSTOM_BRANCH_NAME
	string "latest-stable"

endif

config BR2_PACKAGE_SKELETON_ALPINE_MAKE_ROOTFS_REPOSITORIES
	string "repositories"
	default "main community"
	help
	  Alpine list of repositories to check.

config BR2_PACKAGE_SKELETON_ALPINE_MAKE_ROOTFS_MIRROR
	string "mirror"
	default "https://nl.alpinelinux.org/alpine"
	help
	  URI of the Aports mirror to fetch packages.

endif
```

## package/skeleton-debootstrap/Config.in
```kconfig
config BR2_PACKAGE_SKELETON_DEBOOTSTRAP_ARCH_SUPPORTS
	bool
	default y if BR2_arm || BR2_aarch64 || \
		( BR2_mipsel && BR2_mips_32r2 && !BR2_MIPS_SOFT_FLOAT ) || \
		( BR2_mips64el && BR2_MIPS_NABI64 && !BR2_MIPS_SOFT_FLOAT ) || \
		BR2_powerpc64 || BR2_powerpc64le || \
		( BR2_riscv && BR2_RISCV_64 && BR2_RISCV_ABI_LP64D ) || \
		BR2_s390x || \
		BR2_i386 || BR2_x86_64

config BR2_PACKAGE_SKELETON_DEBOOTSTRAP
	bool "skeleton debootstrap"
	depends on BR2_PACKAGE_SKELETON_DEBOOTSTRAP_ARCH_SUPPORTS
	select BR2_INIT_NONE
	select BR2_PACKAGE_HOST_IAMROOT

if BR2_PACKAGE_SKELETON_DEBOOTSTRAP

choice BR2_PACKAGE_SKELETON_DEBOOTSTRAP_SUITE
	prompt suite
	default BR2_PACKAGE_SKELETON_DEBOOTSTRAP_DEBIAN_STABLE_SUITE
	help
	  The SUITE may be a release code name (eg, sid,
	  stretch, jessie) or a symbolic name (eg, unstable,
	  testing, stable, oldstable).

config BR2_PACKAGE_SKELETON_DEBOOTSTRAP_DEBIAN_12_BOOKWORM_SUITE
	bool "Debian 12 (bookworm)"

config BR2_PACKAGE_SKELETON_DEBOOTSTRAP_DEBIAN_11_BULLSEYE_SUITE
	bool "Debian 11 (bullseye)"

config BR2_PACKAGE_SKELETON_DEBOOTSTRAP_DEBIAN_10_BUSTER_SUITE
	bool "Debian 10 (buster)"

config BR2_PACKAGE_SKELETON_DEBOOTSTRAP_DEBIAN_OLDOLDSTABLE_SUITE
	bool "Debian oldoldstable"

config BR2_PACKAGE_SKELETON_DEBOOTSTRAP_DEBIAN_OLDSTABLE_SUITE
	bool "Debian oldstable"

config BR2_PACKAGE_SKELETON_DEBOOTSTRAP_DEBIAN_STABLE_SUITE
	bool "Debian stable"

config BR2_PACKAGE_SKELETON_DEBOOTSTRAP_DEBIAN_TESTING_SUITE
	bool "Debian testing"

config BR2_PACKAGE_SKELETON_DEBOOTSTRAP_DEBIAN_UNSTABLE_SUITE
	bool "Debian unstable"

config BR2_PACKAGE_SKELETON_DEBOOTSTRAP_CUSTOM_SUITE
	bool "custom"

endchoice

if BR2_PACKAGE_SKELETON_DEBOOTSTRAP_CUSTOM_SUITE

config BR2_PACKAGE_SKELETON_DEBOOTSTRAP_CUSTOM_SUITE_NAME
	string "stable"

endif

config BR2_PACKAGE_SKELETON_DEBOOTSTRAP_MIRROR
	string "mirror"
	default "https://deb.debian.org/debian"
	help
	   MIRROR can be an http:// or https:// URL, a
	   file:/// URL, or an ssh:/// URL.

config BR2_PACKAGE_SKELETON_DEBOOTSTRAP_SCRIPT
	string "script"
	default ""

config BR2_PACKAGE_SKELETON_DEBOOTSTRAP_INCLUDE
	string "include packages"
	default ""
	help
	  Adds specified names to the list of base packages.

config BR2_PACKAGE_SKELETON_DEBOOTSTRAP_EXCLUDE
	string "exclude packages"
	default ""
	help
	  Removes specified packages from the list.

config BR2_PACKAGE_SKELETON_DEBOOTSTRAP_EXTRA_SUITES
	string "extra suites"
	default ""
	help
	  Also use packages from the listed suites of the
	  archive.

config BR2_PACKAGE_SKELETON_DEBOOTSTRAP_COMPONENTS
	string "components"
	default ""
	help
	  use packages from the listed components of the
	  archive.

config BR2_PACKAGE_SKELETON_DEBOOTSTRAP_MERGED_USR
	bool "merged-usr"
	default y
	help
	  Make /{bin,sbin,lib}/ symlinks to /usr/.

endif
```
