## package/skeleton-pacstrap/Config.in
```kconfig
config BR2_PACKAGE_SKELETON_PACSTRAP_ARCH_SUPPORTS
	bool
	default y if BR2_arm || BR2_aarch64 || \
		BR2_powerpc64 || BR2_powerpc64le || \
		( BR2_riscv && BR2_RISCV_64 && BR2_RISCV_ABI_LP64D ) || \
		BR2_i386 || BR2_x86_64

# PowerPC64 big endian by default uses the elfv1 ABI, and PowerPC64 little
# endian by default uses the elfv2 ABI. However, Arch POWER has decided to use
# the elfv2 ABI for both, so we force the ABI for PowerPC64 big endian when the
# selected C library is glibc.
comment "skeleton-pacstrap (Arch POWER powerpc64) needs a buildroot toolchain with elfv2 ABI"
	depends on !BR2_TOOLCHAIN_BUILDROOT
	depends on BR2_PACKAGE_SKELETON_PACSTRAP_ARCH_SUPPORTS
	depends on BR2_powerpc64

config BR2_PACKAGE_SKELETON_PACSTRAP
	bool "skeleton-pacstrap"
	depends on BR2_PACKAGE_SKELETON_PACSTRAP_ARCH_SUPPORTS
	select BR2_INIT_NONE
	select BR2_PACKAGE_HOST_ARCHLINUX_PACMAN
	select BR2_PACKAGE_HOST_ARCH_INSTALL_SCRIPT
	select BR2_PACKAGE_HOST_GNUPG2
	select BR2_PACKAGE_HOST_IAMROOT
	select BR2_PACKAGE_HOST_PACMAN

if BR2_PACKAGE_SKELETON_PACSTRAP

choice
	prompt "configuration file"
	default BR2_PACKAGE_SKELETON_PACSTRAP_ARCHLINUXARM_ARMV7H_CONFIGURATION_FILE if BR2_arm
	default BR2_PACKAGE_SKELETON_PACSTRAP_ARCHLINUXARM_AARCH64_CONFIGURATION_FILE if BR2_aarch64
	default BR2_PACKAGE_SKELETON_PACSTRAP_ARCHPOWER_POWERPC64_CONFIGURATION_FILE if BR2_powerpc64
	default BR2_PACKAGE_SKELETON_PACSTRAP_ARCHPOWER_POWERPC64LE_CONFIGURATION_FILE if BR2_powerpc64le
	default BR2_PACKAGE_SKELETON_PACSTRAP_ARCHLINUXRISCV_RISCV64_CONFIGURATION_FILE if BR2_riscv && BR2_RISCV_64 && BR2_RISCV_ABI_LP64D
	default BR2_PACKAGE_SKELETON_PACSTRAP_ARCHLINUX32_I686_CONFIGURATION_FILE if BR2_i386
	default BR2_PACKAGE_SKELETON_PACSTRAP_ARCHLINUX_X86_64_CONFIGURATION_FILE if BR2_x86_64

config BR2_PACKAGE_SKELETON_PACSTRAP_ARCHLINUXARM_ARMV7H_CONFIGURATION_FILE
	bool "Arch Linux ARM"
	select BR2_PACKAGE_HOST_ARCHLINUXARM_KEYRING
	depends on BR2_arm

config BR2_PACKAGE_SKELETON_PACSTRAP_ARCHLINUXARM_AARCH64_CONFIGURATION_FILE
	bool "Arch Linux ARM"
	select BR2_PACKAGE_HOST_ARCHLINUXARM_KEYRING
	depends on BR2_aarch64

config BR2_PACKAGE_SKELETON_PACSTRAP_MANJAROARM_STABLE_AARCH64_CONFIGURATION_FILE
	bool "Manjaro ARM (stable)"
	select BR2_PACKAGE_HOST_ARCHLINUXARM_KEYRING
	select BR2_PACKAGE_HOST_MANJARO_KEYRING
	depends on BR2_aarch64

config BR2_PACKAGE_SKELETON_PACSTRAP_MANJAROARM_UNSTABLE_AARCH64_CONFIGURATION_FILE
	bool "Manjaro ARM (unstable)"
	select BR2_PACKAGE_HOST_ARCHLINUXARM_KEYRING
	select BR2_PACKAGE_HOST_MANJARO_KEYRING
	depends on BR2_aarch64

config BR2_PACKAGE_SKELETON_PACSTRAP_ARCHPOWER_POWERPC64_CONFIGURATION_FILE
	bool "Arch POWER"
	select BR2_PACKAGE_HOST_ARCHPOWER_KEYRING
	depends on BR2_powerpc64

config BR2_PACKAGE_SKELETON_PACSTRAP_ARCHPOWER_POWERPC64LE_CONFIGURATION_FILE
	bool "Arch POWER"
	select BR2_PACKAGE_HOST_ARCHPOWER_KEYRING
	depends on BR2_powerpc64le

config BR2_PACKAGE_SKELETON_PACSTRAP_ARCHPOWER_RISCV64_CONFIGURATION_FILE
	bool "Arch POWER"
	select BR2_PACKAGE_HOST_ARCHPOWER_KEYRING
	depends on BR2_riscv && BR2_RISCV_64 && BR2_RISCV_ABI_LP64D

config BR2_PACKAGE_SKELETON_PACSTRAP_ARCHLINUXRISCV_RISCV64_CONFIGURATION_FILE
	bool "Arch Linux RISC-V"
	select BR2_PACKAGE_HOST_ARCHLINUXRISCV_KEYRING
	depends on BR2_riscv && BR2_RISCV_64 && BR2_RISCV_ABI_LP64D

config BR2_PACKAGE_SKELETON_PACSTRAP_ARCHLINUX32_I686_CONFIGURATION_FILE
	bool "Arch Linux 32"
	select BR2_PACKAGE_HOST_ARCHLINUX32_KEYRING
	depends on BR2_i386

config BR2_PACKAGE_SKELETON_PACSTRAP_ARCHLINUX_X86_64_CONFIGURATION_FILE
	bool "Arch Linux"
	select BR2_PACKAGE_HOST_ARCHLINUX_KEYRING
	depends on BR2_x86_64

config BR2_PACKAGE_SKELETON_PACSTRAP_MANJARO_STABLE_X86_64_CONFIGURATION_FILE
	bool "Manjaro (stable)"
	select BR2_PACKAGE_HOST_ARCHLINUX_KEYRING
	select BR2_PACKAGE_HOST_MANJARO_KEYRING
	depends on BR2_x86_64

config BR2_PACKAGE_SKELETON_PACSTRAP_MANJARO_UNSTABLE_X86_64_CONFIGURATION_FILE
	bool "Manjaro (unstable)"
	select BR2_PACKAGE_HOST_ARCHLINUX_KEYRING
	select BR2_PACKAGE_HOST_MANJARO_KEYRING
	depends on BR2_x86_64

config BR2_PACKAGE_SKELETON_PACSTRAP_CUSTOM_CONFIGURATION_FILE
	bool "Custom"
	help
	  Use custom configuration file.

endchoice

if BR2_PACKAGE_SKELETON_PACSTRAP_CUSTOM

config BR2_PACKAGE_SKELETON_PACSTRAP_CUSTOM_CONFIGURATION_FILE_PATH
	string "custom configuration file path"
	default "$(SKELETON_PACSTRAP_PKGDIR)/pacman.conf"
	help
	  Use an alternate config file for pacman.
	  Specify an alternate configuration file.

endif

config BR2_PACKAGE_SKELETON_PACSTRAP_PACKAGES
	string "packages"
	default "base"
	help
	  Install packages.
	  If no packages are specified to be installed, the
	  base meta-package will be installed.

endif
```
